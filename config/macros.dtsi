macro_copilot_next: macro_copilot_next{
compatible = "zmk,behavior-macro";
label = "macro_copilot_next";
#binding-cells = <0>;
bindings = <&kp LA(RIGHT_BRACKET)>;
};
macro_copilot_prev: macro_copilot_prev{
compatible = "zmk,behavior-macro";
label = "macro_copilot_prev";
#binding-cells = <0>;
bindings = <&kp LA(LEFT_BRACKET)>;
};
